## drivers/input/touchscreen/mediatek/cst836u/Kconfig
```kconfig
#
# Hynitron CST836U Touchscreen Configuration
#

config TOUCHSCREEN_HYNITRON_TS
	tristate "Hynitron CST836U touchscreen"
	depends on I2C
	depends on INPUT
	select INPUT_MT
	default y
	help
	  Hynitron CST836U I2C touchscreen driver for MediaTek TPD.
```
